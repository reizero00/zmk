## app/boards/shields/nibble/Kconfig.defconfig
```kconfig
# Copyright (c) 2020 Pete Johanson, Jay Greco
# SPDX-License-Identifier: MIT

if SHIELD_NIBBLE

config ZMK_KEYBOARD_NAME
	default "NIBBLE_BLE"

config ZMK_USB
	default y

config ZMK_KSCAN_DEMUX_POLLING
    default y

endif
```

## app/boards/shields/nibble/Kconfig.shield
```kconfig
# Copyright (c) 2020 Pete Johanson, Jay Greco
# SPDX-License-Identifier: MIT

config SHIELD_NIBBLE
	def_bool $(shields_list_contains,nibble)
```

## app/drivers/zephyr/dts/bindings/zmk,kscan-gpio-demux.yaml
```yaml
# Copyright (c) 2020, Pete Johanson
# SPDX-License-Identifier: MIT

description: GPIO keyboard demux controller

compatible: "zmk,kscan-gpio-demux"

include: kscan.yaml

properties:
  row-gpios:
    type: phandle-array
    required: true
  col-gpios:
    type: phandle-array
    required: true
  debounce-period:
    type: int
    default: 5
  total-cols:
    type: int
    default: 16
  diode-direction:
    type: string
    default: row2col
    enum:
      - row2col
      - col2row
```
