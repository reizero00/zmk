/*
 * Copyright (c) 2020 Pete Johanson, Jay Greco
 *
 * SPDX-License-Identifier: MIT
 */

#include <dt-bindings/zmk/matrix-transform.h>

/ {
	chosen {
		zmk,kscan = &kscan0;
	};

	kscan0: kscan {
		compatible = "zmk,kscan-gpio-demux";
		label = "KSCAN";
		diode-direction = "col2row";
		total-cols = <16>;
		row-gpios
			= <&pro_micro_d 15 (GPIO_ACTIVE_LOW | GPIO_PULL_UP)>
			;

		col-gpios
			= <&pro_micro_a 3 GPIO_ACTIVE_HIGH>
			, <&pro_micro_a 2 GPIO_ACTIVE_HIGH>
			, <&pro_micro_a 1 GPIO_ACTIVE_HIGH>
			, <&pro_micro_a 0 GPIO_ACTIVE_HIGH>
			;
	};
};
